## arch/arm64/Kconfig.projects
```kconfig
config SEC_Y2Q_PROJECT
	depends on ARCH_KONA
	default n
	bool "Samsung Y2Q Project"
	help
	  Support for Samsung Y2Q Project

config MACH_Y2Q_JPN_SINGLE
	depends on SEC_Y2Q_PROJECT
	default n
	bool "Samsung Y2Q JPN SINGLE"
	help
	  Support for Samsung Y2Q JPN SINGLE device.

config MACH_Y2Q_JPN_DCMOLY
	default n
	bool "Samsung Y2Q JPN OLY DCMOLY"
	help
	  Support for Samsung Y2Q JPN DCMOLY device.
```
